#include "ssd1306.h"
#include <string.h>

static I2C_HandleTypeDef *s_hi2c;                       // init 时保存句柄
static uint8_t s_fb[SSD1306_WIDTH * SSD1306_PAGES];     // 1024 字节显存，8 页

/* 6x8 ASCII 字模，从空格到 ~，共 95 个 */
static const uint8_t s_font6x8[95][6] =
{
    0x00,0x00,0x00,0x00,0x00,0x00, /* space */
    0x00,0x00,0x00,0x2F,0x00,0x00, /* ! */
    0x00,0x00,0x07,0x00,0x07,0x00, /* " */
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    0x00,0x08,0x04,0x08,0x10,0x08, /* ~ */
};

static void ssd1306_write_cmd(uint8_t cmd)              // 控制字节 0x00 表示命令
{
	uint8_t buf[2] = {0x00, cmd};
	HAL_I2C_Master_Transmit(s_hi2c, SSD1306_I2C_ADDR, buf, 2, 100);
}

static void ssd1306_write_data(const uint8_t *data, uint16_t len)  // 控制字节 0x40 表示数据
{
	uint8_t buf[1 + SSD1306_WIDTH];
	buf[0] = 0x40;
	memcpy(&buf[1], data, len);
	HAL_I2C_Master_Transmit(s_hi2c, SSD1306_I2C_ADDR, buf, len + 1, 100);
}

void ssd1306_init(I2C_HandleTypeDef *hi2c)
{
	static const uint8_t init_cmds[] =
	{
		0xAE,              // 关显示
		0x20, 0x10,        // 水平寻址
		0xB0,              // 页起始
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		0x8D, 0x14,        // 电荷泵开
		0xAF               // 开显示
	};

	s_hi2c = hi2c;
	HAL_Delay(100);                                   // 等屏上电稳定

	for (uint16_t i = 0; i < sizeof(init_cmds); i++)
	{
		ssd1306_write_cmd(init_cmds[i]);
	}

	ssd1306_clear();
	ssd1306_refresh();
}

void ssd1306_clear(void)
{
	memset(s_fb, 0, sizeof(s_fb));
}

void ssd1306_draw_char(uint8_t x, uint8_t page, char c)
{
	if (page >= SSD1306_PAGES || x + 6 > SSD1306_WIDTH)
	{
		return;
	}

	if (c < ' ' || c > '~')
	{
		c = ' ';
	}

	memcpy(&s_fb[page * SSD1306_WIDTH + x], s_font6x8[(uint8_t)c - ' '], 6);
}

void ssd1306_draw_string(uint8_t x, uint8_t page, const char *s)
{
	while (*s != '\0' && x + 6 <= SSD1306_WIDTH)
	{
		ssd1306_draw_char(x, page, *s);
		x += 6;
		s++;
	}
}

void ssd1306_refresh(void)
{
	for (uint8_t page = 0; page < SSD1306_PAGES; page++)
	{
		ssd1306_write_cmd(0xB0 + page);               // 选页
		ssd1306_write_cmd(0x00);                      // 列低 4 位
		ssd1306_write_cmd(0x10);                      // 列高 4 位
		ssd1306_write_data(&s_fb[page * SSD1306_WIDTH], SSD1306_WIDTH);
	}
}
